## M6/reg_proc/Kconfig
```kconfig
menu "Amlogic register module"

config REG
	tristate "Register Driver added by Eric Xie" 
	default m
	help
   		Read or write register from physical memory.

endmenu
```

## m1/reg_char/Kconfig
```kconfig
menu "Amlogic register module"

config REG
	tristate "Register Driver added by Eric Xie" 
	default n
	help
   		Read or write register from physical memory.

endmenu
```
